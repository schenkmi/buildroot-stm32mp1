## package/qt-sensor-demo/Config.in
```kconfig
config BR2_PACKAGE_QT_SENSOR_DEMO
	bool "qt-sensor-demo"
	depends on BR2_PACKAGE_QT5
	select BR2_PACKAGE_QT5BASE_WIDGETS
	help
	  This is the qt-sensor-demo application.
```
